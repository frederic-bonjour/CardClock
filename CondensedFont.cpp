#include <Arduino.h>
#include "CondensedFont.h"


CondensedFont::CondensedFont() {}


byte CondensedFont::getCharWidth(char c) {
    if (c == ' ') return 3;
    byte ci = getCharIndex(c);
    if (ci >= 59) {
        return 3;
    }
    byte* ch = chars[ci];
    if (! ch) {
        return 3;
    }
    return ch[getHeight()];
}


byte CondensedFont::getCharIndex(char c) {
    // Special chars
    switch (c) {
        case 95:
            return 59;
        case 176:
            return 58;
    }
    
    // lowercase -> UPPERCASE
    if (c >= 97 && c <= 122) {
        c -= 32;
    }
    
    c -= 33; // Skip non-printable chars		
    
    return c;
}


byte* CondensedFont::getChar(char c) {
    byte index = getCharIndex(c);
    if (index < CondensedFontCharCount) {
        return chars[index];
    }
    return NULL;
}


byte CondensedFont::getHeight() {
    return 7;
}


bool CondensedFont::handlesDiacritics() {
    return false;
}


byte CondensedFont::chars[CondensedFontCharCount][8] = {
    // 33 (0)
    
    { 0x01, 0x01, 0x01, 0x00, 0x01, 1 }, // !
    { 0x05, 0x05, 0x00, 0x00, 0x00, 3 }, // "
    { 0x0A, 0x1F, 0x0A, 0x1F, 0x0A, 5 }, // #
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    { 0x01, 0x02, 0x04, 0x08, 0x10, 5 }, // /
    
    // 48 (15)
    
    // Digits
    { B00011111, B00010001, B00010001, B00010001, B00010001, B00010001, B00011111, 5 }, // 0
    { B00000001, B00000011, B00000001, B00000001, B00000001, B00000001, B00000001, 2 }, // 1
    { B00011111, B00000001, B00000001, B00011111, B00010000, B00010000, B00011111, 5 }, // 2
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    { 0x0E, 0x15, 0x17, 0x10, 0x0E, 5 }, // @

    // Capital letters A-Z
    // 65 (32)
    { 0x07, 0x05, 0x07, 0x05, 0x05, 3 }, // A
    { 0x0E,	0x09, 0x0E, 0x09, 0x0E, 4 }, // B000
    { 0x07,	0x04, 0x04,	0x04, 0x07, 3 }, // C
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    { 0x07, 0x01, 0x02, 0x04, 0x07, 3 }, // Z

    // Special chars
    // (58)
    { 0x07, 0x05, 0x07, 0x00, 0x00, 3 }, // °
    { 0x00, 0x00, 0x00, 0x00, 0x0F, 4 }  // _
    
    // l1    l2    l3    l4    l5   ^ width
};
